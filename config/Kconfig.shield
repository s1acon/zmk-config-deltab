## config/Kconfig.shield
```kconfig
# Copyright (c) 2020 Pete Johanson
# SPDX-License-Identifier: MIT

config SHIELD_DELTAB_LEFT
    def_bool $(shields_list_contains,deltab_left)

config SHIELD_DELTAB_RIGHT
    def_bool $(shields_list_contains,deltab_right)
```
